## boards/renesas/rzg3s_smarc/rzg3s_smarc_r9a08g045s33gbg_cm33_defconfig
```kconfig
# Copyright (c) 2024 EPAM Systems
# Copyright (c) 2024 Renesas Electronics Corporation
# SPDX-License-Identifier: Apache-2.0

CONFIG_SYS_CLOCK_EXISTS=y

CONFIG_XIP=n

CONFIG_MAIN_STACK_SIZE=4096

# Enable UART driver
CONFIG_SERIAL=y

# Enable console
CONFIG_CONSOLE=y
CONFIG_UART_CONSOLE=y

# This is required to support debug with xSPI boot when Zephyr already booted by TF-A
CONFIG_INIT_ARCH_HW_AT_BOOT=y
```

## boards/sensoan/sgw2/Kconfig
```kconfig
# SGW-2 board configuration
#
# Copyright (c) 2019 Nordic Semiconductor ASA
# Copyright (c) 2024 Sensoan Oy
#
# SPDX-License-Identifier: Apache-2.0

if BOARD_SGW2_NRF9160 || BOARD_SGW2_NRF9160_NS

config BOARD_INIT_PRIORITY
	int "Initialization priority for board configuration"
	default 80

endif # BOARD_SGW2_NRF9160 || BOARD_SGW2_NRF9160_NS

if BOARD_SGW2_NRF5340_CPUAPP || BOARD_SGW2_NRF5340_CPUAPP_NS || BOARD_SGW2_NRF5340_CPUNET

if BOARD_SGW2_NRF5340_CPUAPP || BOARD_SGW2_NRF5340_CPUAPP_NS

config DOMAIN_CPUNET_BOARD
	string
	default "sgw2/nrf5340/cpunet"
	help
	  The board which will be used for CPUNET domain when creating a multi
	  image application where one or more images should be located on
	  another board. For example hci_rpmsg on the nRF5340_cpunet for
	  Bluetooth applications.

endif #  BOARD_SGW2_NRF5340_CPUAPP || BOARD_SGW2_NRF5340_CPUAPP_NS

config DOMAIN_CPUAPP_BOARD
	string
	default "sgw2/nrf5340/cpuapp"
	depends on BOARD_SGW2_NRF5340_CPUNET
	help
	  The board which will be used for CPUAPP domain when creating a multi
	  image application where one or more images should be located on
	  another board.

endif # BOARD_SGW2_NRF5340_CPUAPP || BOARD_SGW2_NRF5340_CPUAPP_NS || BOARD_SGW2_NRF5340_CPUNET

if DT_HAS_NORDIC_NRF_SPIM_ENABLED && DT_HAS_JEDEC_SPI_NOR_ENABLED

config SGW2_SPI_FLASH
	bool "Imply config options for external flash"
	imply FLASH
	imply MULTITHREADING
	imply SPI_NOR
	default y

endif

module=BOARD
module-dep=LOG
module-str=Log level for board
source "${ZEPHYR_BASE}/subsys/logging/Kconfig.template.log_config"
```

## boards/sparkfun/artemis_nano/Kconfig.artemis_nano
```kconfig
# SPDX-License-Identifier: Apache-2.0
# Copyright (c) 2024 Ali Sarlak

config BOARD_ARTEMIS_NANO
	select SOC_APOLLO3_BLUE
```

## drivers/input/Kconfig.tsc_keys
```kconfig
# Copyright (c) 2024 Arif Balik <arifbalik@outlook.com>
# SPDX-License-Identifier: Apache-2.0

config INPUT_TSC_KEYS
	bool "STM32 TSC touch library"
	default y
	depends on STM32_TSC
	select RING_BUFFER
	help
	  Enable support for STM32 TSC touch library.

config INPUT_TSC_KEYS_BUFFER_WORD_SIZE
	int "STM32 TSC touch buffer size in words"
	default 10
	depends on INPUT_TSC_KEYS
	help
	  Set the size of the buffer for the STM32 TSC touch library.
```

## drivers/misc/stm32_tsc/Kconfig
```kconfig
# Copyright (c) 2024 Arif Balik <arifbalik@outlook.com>
# SPDX-License-Identifier: Apache-2.0

config STM32_TSC
	bool "STM32 TSC driver"
	default y
	depends on DT_HAS_ST_STM32_TSC_ENABLED
	help
	  Enable driver for STM32 TSC peripheral.

config STM32_TSC_INTERRUPT
	bool "Use interrupt for STM32 TSC"
	default y
	depends on STM32_TSC
	help
	  Use interrupt for STM32 TSC peripheral.
```

## dts/bindings/misc/st,stm32-tsc.yaml
```yaml
# Copyright (c) 2024 Arif Balik <arifbalik@outlook.com>
# SPDX-License-Identifier: Apache-2.0

description: STM32 Tocuh Sensing Controller (TSC) driver

compatible: "st,stm32-tsc"

include: [base.yaml, pinctrl-device.yaml, reset-device.yaml]

properties:
  reg:
    required: true
  clocks:
    required: true
  resets:
    required: true
  interrupts:
    required: true
  pinctrl-0:
    required: true
  pinctrl-names:
    required: true

  pulse-generator-prescaler:
    type: int
    default: 2
    description: |
      Prescaler for the pulse generator clock (t_pgclk=f_hclk/prescaler).
      The prescaler is used to generate the charge transfer pulse.
      0: f_hclk/1
      1: f_hclk/2
      2: f_hclk/4
      3: f_hclk/8
      4: f_hclk/16
      5: f_hclk/32
      6: f_hclk/64
      7: f_hclk/128
    enum: [0, 1, 2, 3, 4, 5, 6, 7]

  ctph:
    type: int
    default: 2
    description: |
      Number of cycles for the high state of the
      charge transfer pulse (1 to 16 cycles of t_pgclk).
    enum: [1, 2, 3, 4, 5, 6, 7, 8, 9, 10, 11, 12, 13, 14, 15, 16]

  ctpl:
    type: int
    default: 2
    description: |
      Number of cycles for the low state of the
      charge transfer pulse (1 to 16 cycles of t_pgclk).
    enum: [1, 2, 3, 4, 5, 6, 7, 8, 9, 10, 11, 12, 13, 14, 15, 16]

  spread-spectrum:
    type: boolean
    description: Spread spectrum enable

  spread-spectrum-prescaler:
    type: int
    default: 1
    description: Spread spectrum clock prescaler (t_ssclk)
    enum:
      - 1
      - 2

  spread-spectrum-deviation:
    type: int
    default: 1
    description: Spread spectrum deviation (1 to 128 cycles of t_ssclk)

  max-count-value:
    type: int
    default: 5
    description: |
      Max number of charge transfer pulses before max count error is generated.
      0: 255
      1: 511
      2: 1023
      3: 2047
      4: 4095
      5: 8191
      6: 16383
      7: 32767
    enum: [0, 1, 2, 3, 4, 5, 6, 7]

  synced-acquisition:
    type: boolean
    description: |
      Synchronized acquisition enable.
      Acquisition starts when START bit and signal on sync pin.
      You have to provide a pinctrl for the sync pin.

  syncpol-rising:
    type: boolean
    description: Rising synchronization pin polarity, instead of falling

  iodef-float:
    type: boolean
    description: |
      Set default state (not acqusition) of all channel I/Os to floating.
      push-pull down by default.

child-binding:
  description: STM32 TSC group configuration
  properties:
    group:
      type: int
      required: true
      description: Group number (0 to 7)
      enum: [0, 1, 2, 3, 4, 5, 6, 7]

    channel-ios:
      type: int
      default: 1
      description: Channel I/Os to be enabled
      enum: [1, 2, 3, 4, 5, 6, 7, 8, 9, 10, 11, 12, 13, 14, 15, 16]

    sampling-io:
      type: int
      required: true
      description: Channel to be selected for sampling
      enum:
        - 1
        - 2
        - 4
        - 8

    use-as-shield:
      type: boolean
      description: |
        Use channel as shield. This configures group but
        does not enable it for acqusition. channel-io is used
        as shield pin and can only have values 1, 2, 4 or 8.
```

## dts/bindings/stepper/adi/adi,tmc2209.yaml
```yaml
# SPDX-FileCopyrightText: Copyright (c) 2024 Fabian Blatz <fabianblatz@gmail.com>
# SPDX-License-Identifier: Apache-2.0

description: |
  Device tree binding for the Analog Devices TMC2209 stepper motor driver.

compatible: "adi,tmc2209"

include:
  - name: zephyr,step-direction-stepper-common.yaml
  - name: stepper-controller.yaml
    property-allowlist:
      - micro-step-res

properties:
  enable-gpios:
    type: phandle-array
    description: |
      GPIO pins used to control the enable signal of the motor driver.

  msx-gpios:
    type: phandle-array
    description: |
      An array of GPIO pins for configuring the microstep resolution of the driver.
      The pins should be listed in the following order:
      - MS1
      - MS2
```

## dts/bindings/stepper/zephyr,step-direction-stepper-common.yaml
```yaml
# Copyright (c) 2024 Fabian Blatz <fabianblatz@gmail.com>
# SPDX-License-Identifier: Apache-2.0

description: |
    This binding provides a stepper controller that can be used with a stepper motor that
    accepts step and direction signals.

include: base.yaml

properties:
  step-gpios:
    type: phandle-array
    description: |
      The GPIO pins that are used to send step signals to the stepper motor.

  direction-gpios:
    type: phandle-array
    description: |
      The GPIO pins that are used to send direction signals to the stepper motor.
      Pin will be driven high for forward direction and low for reverse direction.

  dual-edge-step:
    type: boolean
    description: |
      If present, the stepper motor controller supports dual edge step signals.
```

## modules/nrf_wifi/bus/Kconfig
```kconfig
#
# Copyright (c) 2024 Nordic Semiconductor
#
# SPDX-License-Identifier: Apache-2.0
#

DT_COMPAT_NORDIC_NRF70_QSPI := nordic,nrf7002-qspi
DT_COMPAT_NORDIC_NRF70_SPI := nordic,nrf7002-spi

menuconfig NRF70_BUSLIB
	bool "NRF70 Bus Library"
	help
	  Enable the NRF70 Bus Library for the nRF7002 Wi-Fi shield.

if NRF70_BUSLIB

config NRF70_ON_QSPI
	def_bool $(dt_compat_enabled,$(DT_COMPAT_NORDIC_NRF70_QSPI))
	select NRFX_QSPI

config NRF70_ON_SPI
	def_bool $(dt_compat_enabled,$(DT_COMPAT_NORDIC_NRF70_SPI))
	select SPI

module = WIFI_NRF70_BUSLIB
module-dep = LOG
module-str = Log level for Wi-Fi nRF70 bus library
source "${ZEPHYR_BASE}/subsys/logging/Kconfig.template.log_config"

config WIFI_NRF70_BUSLIB_LOG_LEVEL
	# Enable error by default
	default 1

config NRF70_LOG_VERBOSE
	bool "Maintains the verbosity of information in logs"
	default y

endif # NRF70_BUSLIB
```

## samples/bluetooth/central/sample.yaml
```yaml
sample:
  name: Bluetooth Central
tests:
  sample.bluetooth.central:
    harness: bluetooth
    platform_allow:
      - qemu_cortex_m3
      - qemu_x86
    tags: bluetooth
    integration_platforms:
      - qemu_cortex_m3
  sample.bluetooth.central.esp32:
    extra_args:
      - CONFIG_BT_BUILD_ONLY_MODE=y
    platform_allow:
      - esp32_devkitc_wroom/esp32/procpu
      - esp32s3_devkitm/esp32s3/procpu
      - esp32c3_devkitm
```

## tests/bsim/bluetooth/host/adv/long_ad/testcase.yaml
```yaml
tests:
  bluetooth.host.adv.long_ad:
    build_only: true
    tags:
      - bluetooth
    platform_allow:
      - nrf52_bsim
    harness: bsim
    harness_config:
      bsim_exe_name: tests_bsim_bluetooth_host_adv_long_ad_prj_conf
```

## tests/bsim/bluetooth/host/att/long_read/testcase.yaml
```yaml
tests:
  bluetooth.host.att.long_read:
    build_only: true
    tags:
      - bluetooth
    platform_allow:
      - nrf52_bsim
    harness: bsim
    harness_config:
      bsim_exe_name: tests_bsim_bluetooth_host_att_long_read_prj_conf
```

## tests/bsim/bluetooth/host/att/open_close/testcase.yaml
```yaml
tests:
  bluetooth.host.att.open_close:
    build_only: true
    tags:
      - bluetooth
    platform_allow:
      - nrf52_bsim
    harness: bsim
    harness_config:
      bsim_exe_name: tests_bsim_bluetooth_host_att_open_close_prj_conf
```

## tests/bsim/bluetooth/host/att/read_fill_buf/client/testcase.yaml
```yaml
tests:
  bluetooth.host.att.read_fill_buf.client:
    build_only: true
    tags:
      - bluetooth
    platform_allow:
      - nrf52_bsim
    harness: bsim
    harness_config:
      bsim_exe_name: tests_bsim_bluetooth_host_att_read_fill_buf_client_prj_conf
```

## tests/bsim/bluetooth/host/att/read_fill_buf/server/testcase.yaml
```yaml
tests:
  bluetooth.host.att.read_fill_buf.server:
    build_only: true
    tags:
      - bluetooth
    platform_allow:
      - nrf52_bsim
    harness: bsim
    harness_config:
      bsim_exe_name: tests_bsim_bluetooth_host_att_read_fill_buf_server_prj_conf
```

## tests/bsim/bluetooth/host/att/retry_on_sec_err/client/testcase.yaml
```yaml
tests:
  bluetooth.host.att.retry_on_sec_err.client:
    build_only: true
    tags:
      - bluetooth
    platform_allow:
      - nrf52_bsim
    harness: bsim
    harness_config:
      bsim_exe_name: tests_bsim_bluetooth_host_att_retry_on_sec_err_client_prj_conf
```

## tests/bsim/bluetooth/host/att/sequential/tester/testcase.yaml
```yaml
tests:
  bluetooth.host.att.sequential.tester:
    build_only: true
    tags:
      - bluetooth
    platform_allow:
      - nrf52_bsim
    harness: bsim
    harness_config:
      bsim_exe_name: tests_bsim_bluetooth_host_att_sequential_tester_prj_conf
```

## tests/bsim/bluetooth/host/att/timeout/testcase.yaml
```yaml
tests:
  bluetooth.host.att.timeout:
    build_only: true
    tags:
      - bluetooth
    platform_allow:
      - nrf52_bsim
    harness: bsim
    harness_config:
      bsim_exe_name: tests_bsim_bluetooth_host_att_timeout_prj_conf
```

## tests/bsim/bluetooth/host/gatt/notify/testcase.yaml
```yaml
tests:
  bluetooth.host.gatt.notify:
    build_only: true
    tags:
      - bluetooth
    platform_allow:
      - nrf52_bsim
    harness: bsim
    harness_config:
      bsim_exe_name: tests_bsim_bluetooth_host_gatt_notify_prj_conf
```

## tests/bsim/bluetooth/host/gatt/notify_multiple/testcase.yaml
```yaml
tests:
  bluetooth.host.gatt.notify_multiple:
    build_only: true
    tags:
      - bluetooth
    platform_allow:
      - nrf52_bsim
    harness: bsim
    harness_config:
      bsim_exe_name: tests_bsim_bluetooth_host_gatt_notify_multiple_prj_conf
```

## tests/bsim/bluetooth/host/id/settings/testcase.yaml
```yaml
tests:
  bluetooth.host.id.settings:
    build_only: true
    tags:
      - bluetooth
    platform_allow:
      - nrf52_bsim
    harness: bsim
    harness_config:
      bsim_exe_name: tests_bsim_bluetooth_host_id_settings_prj_conf
```

## tests/bsim/bluetooth/host/iso/bis/testcase.yaml
```yaml
tests:
  bluetooth.host.iso.bis:
    build_only: true
    tags:
      - bluetooth
    platform_allow:
      - nrf52_bsim
    harness: bsim
    harness_config:
      bsim_exe_name: tests_bsim_bluetooth_host_iso_bis_prj_conf
```

## tests/bsim/bluetooth/host/iso/cis/testcase.yaml
```yaml
tests:
  bluetooth.host.iso.cis:
    build_only: true
    tags:
      - bluetooth
    platform_allow:
      - nrf52_bsim
    harness: bsim
    harness_config:
      bsim_exe_name: tests_bsim_bluetooth_host_iso_cis_prj_conf
```

## tests/bsim/bluetooth/host/iso/frag_2/testcase.yaml
```yaml
tests:
  bluetooth.host.iso.frag_2:
    build_only: true
    tags:
      - bluetooth
    platform_allow:
      - nrf52_bsim
    harness: bsim
    harness_config:
      bsim_exe_name: tests_bsim_bluetooth_host_iso_frag_2_prj_conf
```

## tests/bsim/bluetooth/host/l2cap/ecred/dut/testcase.yaml
```yaml
tests:
  bluetooth.host.l2cap.ecred.dut:
    build_only: true
    tags:
      - bluetooth
    platform_allow:
      - nrf52_bsim
    harness: bsim
    harness_config:
      bsim_exe_name: tests_bsim_bluetooth_host_l2cap_ecred_dut_prj_conf
```
