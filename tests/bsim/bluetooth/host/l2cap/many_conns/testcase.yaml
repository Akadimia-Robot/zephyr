## tests/bsim/bluetooth/host/l2cap/many_conns/testcase.yaml
```yaml
tests:
  bluetooth.host.l2cap.many_conns:
    build_only: true
    tags:
      - bluetooth
    platform_allow:
      - nrf52_bsim
    harness: bsim
    harness_config:
      bsim_exe_name: tests_bsim_bluetooth_host_l2cap_many_conns_prj_conf
```

## tests/bsim/bluetooth/host/l2cap/reassembly/peer/testcase.yaml
```yaml
tests:
  bluetooth.host.l2cap.reassembly.peer:
    build_only: true
    tags:
      - bluetooth
    platform_allow:
      - nrf52_bsim
    harness: bsim
    harness_config:
      bsim_exe_name: tests_bsim_bluetooth_host_l2cap_reassembly_peer_prj_conf
```

## tests/bsim/bluetooth/host/l2cap/split/dut/testcase.yaml
```yaml
tests:
  bluetooth.host.l2cap.split.dut:
    build_only: true
    tags:
      - bluetooth
    platform_allow:
      - nrf52_bsim
    harness: bsim
    harness_config:
      bsim_exe_name: tests_bsim_bluetooth_host_l2cap_split_dut_prj_conf
```

## tests/bsim/bluetooth/host/l2cap/userdata/testcase.yaml
```yaml
tests:
  bluetooth.host.l2cap.userdata:
    build_only: true
    tags:
      - bluetooth
    platform_allow:
      - nrf52_bsim
    harness: bsim
    harness_config:
      bsim_exe_name: tests_bsim_bluetooth_host_l2cap_userdata_prj_conf
```

## tests/bsim/bluetooth/host/scan/start_stop/testcase.yaml
```yaml
tests:
  bluetooth.host.scan.start_stop:
    build_only: true
    tags:
      - bluetooth
    platform_allow:
      - nrf52_bsim
    harness: bsim
    harness_config:
      bsim_exe_name: tests_bsim_bluetooth_host_scan_start_stop_prj_conf
```

## tests/bsim/bluetooth/host/security/bond_per_connection/testcase.yaml
```yaml
tests:
  bluetooth.host.security.bond_per_connection:
    build_only: true
    tags:
      - bluetooth
    platform_allow:
      - nrf52_bsim
    harness: bsim
    harness_config:
      bsim_exe_name: tests_bsim_bluetooth_host_security_bond_per_connection_prj_conf
```

## tests/classic/sdp_c/testcase.yaml
```yaml
tests:
  sdp.c:
    platform_allow:
      - mimxrt1170_evk@B/mimxrt1176/cm7
    tags:
      - bluetooth
      - sdp
    integration_platforms:
      - mimxrt1170_evk@B/mimxrt1176/cm7
    harness: pytest
    harness_config:
      pytest_dut_scope: session
      fixture: bumble
      pytest_args: ['--log-level=DEBUG']
    timeout: 150
```

## tests/drivers/misc/stm32_tsc/testcase.yaml
```yaml
tests:
  drivers.misc.stm32_tsc:
    tags: drivers misc stm32 tsc
    filter: dt_compat_enabled("st,stm32-tsc")
    depends_on: tsc
  drivers.misc.stm32_tsc_poll:
    tags: drivers misc stm32 tsc poll
    filter: dt_compat_enabled("st,stm32-tsc")
    depends_on: tsc
    extra_args: CONFIG_STM32_TSC_INTERRUPT=n
```
